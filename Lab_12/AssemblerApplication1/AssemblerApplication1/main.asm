cli ; заборона переривань"
; DDR"
ldi r16, 1 << PB1 ; завантаження константи "0010 0000" в регіст r16"
out DDRB, r16 ; перенесення з регістру r16 у I/O регістр DDRB"

ldi r16, (1 << PC1) | (1 << PC5) ; завантаження константи "0010 0010" в регіст r16"
out DDRC, r16 ; перенесення з регістру r16 у I/O регістр DDRC"

ldi r16, (1 << PD1) | (1 << PD4) ; завантаження константи "1000 1000" в регіст r16"
out DDRD, r16 ; перенесення з регістру r16 у I/O регістр DDRD"

; PORT (робим підтяжку на пінах з кнопками)"
ldi r16, 1 << PB0 ; завантаження константи "0001 0000" в регіст r16"
out PORTB, r16 ; перенесення з регістру r16 у I/O регістр PORTB"

ldi r16, (1 << PC0) | (1 << PC4) ; завантаження константи "0001 0001" в регіст r16"
out PORTC, r16 ; перенесення з регістру r16 у I/O регістр PORTC"

ldi r16, (1 << PD0) | (1 << PD5) ; завантаження константи "0100 0100" в регіст r16"
out PORTD, r16 ; перенесення з регістру r16 у I/O регістр PORTD"

sei ; дозвіл переривань"

start:
cli ; заборона переривань"
; на Arduino Uno світлодіод на pin 13, а кнопка на pin 12"
in r16, PINB ; пересилання з I/O регістра PINB у регістр r16"
sbrc r16, PB0 ; пропустити наступну команду, якщо 4й біт в регістрі r16 очищен (дорівнює 0)"
sbi PORTB, PB1 ; встановлення 5го біту в I/O регістрі PORTB в 1"
nop ; після пропуску команди, потрапляєм сюди (тут нічого не відбувається)"
sbrs r16, PB0 ; пропустити наступну команду, якщо 4й біт в регістрі r16 встановлен (дорівнює 1)"
cbi PORTB, PB1 ; скидання 5го біту в I/O регістрі PORTB в 0"
nop ; після пропуску команди, потрапляєм сюди (тут нічого не відбувається)"

; на Arduino Uno світлодіод на A1, а кнопка на A0"
in r16, PINC ; пересилання з I/O регістра PINC у регістр r16"
sbrc r16, PC0 ; пропустити наступну команду, якщо 0й біт в регістрі r16 очищен (дорівнює 0)"
sbi PORTC, PC1 ; встановлення 1го біту в I/O регістрі PORTC в 1"
nop ; після пропуску команди, потрапляєм сюди (тут нічого не відбувається)"
sbrs r16, PC0 ; пропустити наступну команду, якщо 0й біт в регістрі r16 встановлен (дорівнює 1)"
cbi PORTC, PC1 ; скидання 1го біту в I/O регістрі PORTC в 0"
nop ; після пропуску команди, потрапляєм сюди (тут нічого не відбувається)"

; на Arduino Uno світлодіод на A5, а кнопка на A4"
in r16, PINC ; пересилання з I/O регістра PINC у регістр r16"
sbrc r16, PC4 ; пропустити наступну команду, якщо 4й біт в регістрі r16 очищен (дорівнює 0)"
sbi PORTC, PC5 ; встановлення 5го біту в I/O регістрі PORTC в 1"
nop ; після пропуску команди, потрапляєм сюди (тут нічого не відбувається)"
sbrs r16, PC4 ; пропустити наступну команду, якщо 4й біт в регістрі r16 встановлен (дорівнює 1)"
cbi PORTC, PC5 ; скидання 5го біту в I/O регістрі PORTC в 0"
nop ; після пропуску команди, потрапляєм сюди (тут нічого не відбувається)"

; на Arduino Uno світлодіод на pin 3, а кнопка на pin 2"
in r16, PIND ; пересилання з I/O регістра PIND у регістр r16"
sbrc r16, PD0 ; пропустити наступну команду, якщо 2й біт в регістрі r16 очищен (дорівнює 0)"
sbi PORTD, PD1 ; встановлення 3го біту в I/O регістрі PORTD в 1"
nop ; після пропуску команди, потрапляєм сюди (тут нічого не відбувається)"
sbrs r16, PD0 ; пропустити наступну команду, якщо 2й біт в регістрі r16 встановлен (дорівнює 1)"
cbi PORTD, PD1 ; скидання 3го біту в I/O регістрі PORTD в 0"
nop ; після пропуску команди, потрапляєм сюди (тут нічого не відбувається)"

; на Arduino Uno світлодіод на pin 7, а кнопка на pin 6"
in r16, PIND ; пересилання з I/O регістра PIND у регістр r16"
sbrc r16, PD5 ; пропустити наступну команду, якщо 6й біт в регістрі r16 очищен (дорівнює 0)"
sbi PORTD, PD4 ; встановлення 7го біту в I/O регістрі PORTD в 1"
nop ; після пропуску команди, потрапляєм сюди (тут нічого не відбувається)"
sbrs r16, PD5 ; пропустити наступну команду, якщо 6й біт в регістрі r16 встановлен (дорівнює 1)"
cbi PORTD, PD4 ; скидання 7го біту в I/O регістрі PORTD в 0"
nop ; після пропуску команди, потрапляєм сюди (тут нічого не відбувається)"

sei ; дозвіл переривань"
rjmp start
